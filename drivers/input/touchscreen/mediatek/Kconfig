## drivers/input/touchscreen/mediatek/Kconfig
```kconfig
config MTK_FT5206
	bool "FT5206 for Mediatek package"
	default n
	help
	  Say Y here to enable MTK_FT5206 touchscreen support.

	  If unsure, say N.

	  To compile this driver as a module, choose M here: the
	  module will be called MTK_FT5206.

config TOUCHSCREEN_MTK_ATMEL_MXT336
	bool "ATMEL_MXT336 for Mediatek package"
	default n
	help
	  Say Y here to enable MTK_FT5206 touchscreen support.

	  If unsure, say N.

	  To compile this driver as a module, choose M here: the
	  module will be called MTK_FT5206.
```

## drivers/misc/mediatek/accelerometer/Kconfig
```kconfig
config MTK_AUTO_DETECT_ACCELEROMETER
	bool "MTK_AUTO_DETECT_ACCELEROMETER"
	depends on MTK_SENSOR_SUPPORT
	help
	  one load to support different accelerometer sensor

config CUSTOM_KERNEL_ACCELEROMETER
	bool "CUSTOM_KERNEL_ACCELEROMETER"
	help
	  accelerometer sensor to detect accelerometer from x y z axis.

source "drivers/misc/mediatek/accelerometer/bmi160_acc/Kconfig"
```

## drivers/misc/mediatek/lens/Kconfig
```kconfig
config MTK_LENS
  bool CONFIG_MTK_LENS
  default n
  help
    CONFIG_MTK_LENS

config MTK_LENS_DW9761BAF_SUPPORT
	bool "DW9761BAF Lens Driver"
	default n
```

## drivers/misc/mediatek/magnetometer/Kconfig
```kconfig
config MTK_AUTO_DETECT_MAGNETOMETER
	bool "MTK_AUTO_DETECT_MAGNETOMETER"
	help
	  one load to support different magnetometer sensor

config CUSTOM_KERNEL_MAGNETOMETER
	bool "CUSTOM_KERNEL_MAGNETOMETER"
	help
	  compass driver to detect compass raw data and report orientatino
	  data

source "drivers/misc/mediatek/magnetometer/akm09911-new/Kconfig"
```
